## boards/shields/the-forty-six/Kconfig.defconfig
```kconfig
if SHIELD_THE_FORTY_SIX_LEFT

# Name must be less than 16 characters long!
config ZMK_KEYBOARD_NAME
    default "The Forty Six"

config ZMK_SPLIT_ROLE_CENTRAL
    default y

endif

if SHIELD_THE_FORTY_SIX_LEFT || SHIELD_THE_FORTY_SIX_RIGHT

config ZMK_SPLIT
    default y

endif
```

## boards/shields/the-forty-six/Kconfig.shield
```kconfig
config SHIELD_THE_FORTY_SIX_LEFT
    def_bool $(shields_list_contains,the_forty_six_left)

config SHIELD_THE_FORTY_SIX_RIGHT
    def_bool $(shields_list_contains,the_forty_six_right)
```

## boards/shields/the46/Kconfig.defconfig
```kconfig
if SHIELD_THE46_LEFT

# Name must be less than 16 characters long!
config ZMK_KEYBOARD_NAME
    default "The Forty Six"

config ZMK_SPLIT_ROLE_CENTRAL
    default y

endif

if SHIELD_THE46_LEFT || SHIELD_THE46_RIGHT

config ZMK_SPLIT
    default y

endif
```

## boards/shields/the46/Kconfig.shield
```kconfig
config SHIELD_THE46_LEFT
    def_bool $(shields_list_contains,the46_left)

config SHIELD_THE46_RIGHT
    def_bool $(shields_list_contains,the46_right)
```
